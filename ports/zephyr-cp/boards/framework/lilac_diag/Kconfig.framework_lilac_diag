## ports/zephyr-cp/boards/framework/lilac_diag/board.yml
```yaml
board:
  name: framework_lilac_diag
  full_name: Framework Lilac AP-off diagnostic candidate
  vendor: framework
  socs:
    - name: npcx9m3f
```

## ports/zephyr-cp/boards/framework/npcx993/board.yml
```yaml
board:
  name: framework_npcx993
  full_name: Framework NPCX993 experimental UART target
  vendor: framework
  socs:
    - name: npcx9m3f
```

## ports/zephyr-cp/boards/framework/npcx993/framework_npcx993_defconfig
```kconfig
CONFIG_NPCX_HEADER=y
CONFIG_NPCX_IMAGE_OUTPUT_HEX=y
CONFIG_CLOCK_CONTROL=y
CONFIG_SERIAL=y
CONFIG_UART_INTERRUPT_DRIVEN=y
CONFIG_GPIO=y
CONFIG_CONSOLE=y
CONFIG_UART_CONSOLE=y
```
